## lcd16x2/Kconfig
```kconfig
menu "LCD 16x2 I2C Display Driver"

config LCD_16x2
        tristate "LCD 16x2 I2C Display Driver"
        depends on I2C && SYSFS
        help
          Enable this driver to get read/write in display LCD 16x4 with
          the chip PCF8574.

endmenu
```

## lcd16x4/Kconfig
```kconfig
menu "LCD 16x4 I2C Display Driver"

config LCD_16x4
        tristate "LCD 16x4 I2C Display Driver"
        depends on I2C && SYSFS
        help
          Enable this driver to get read/write in display LCD 16x4 with
          the chip PCF8574.

endmenu
```
